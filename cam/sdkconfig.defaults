## cam/sdkconfig.defaults
```kconfig
# Override some defaults in mesh application project.

#
# Serial flasher config
#
CONFIG_ESPTOOLPY_FLASHSIZE_4MB=y
CONFIG_ESPTOOLPY_FLASHMODE_QIO=y
CONFIG_ESPTOOLPY_FLASHFREQ_80M=y

#
# Partition Table
#
CONFIG_PARTITION_TABLE_CUSTOM=y

#
# Compiler options DEBUG
#
CONFIG_OPTIMIZATION_LEVEL_DEBUG=y
CONFIG_OPTIMIZATION_ASSERTIONS_ENABLED=y
CONFIG_COMPILER_STACK_CHECK_MODE_NORM=y
CONFIG_STACK_CHECK=y
CONFIG_WARN_WRITE_STRINGS=y
CONFIG_LOG_DEFAULT_LEVEL_DEBUG=y

#
# FreeRTOS
#
CONFIG_FREERTOS_UNICORE=y
CONFIG_FREERTOS_HZ=1000
CONFIG_TIMER_TASK_STACK_DEPTH=3072
CONFIG_FREERTOS_USE_TRACE_FACILITY=y
CONFIG_FREERTOS_USE_STATS_FORMATTING_FUNCTIONS=y
CONFIG_FREERTOS_VTASKLIST_INCLUDE_COREID=y
CONFIG_FREERTOS_GENERATE_RUN_TIME_STATS=y

#
# ESP32-specific
#
CONFIG_TASK_WDT_PANIC=y
CONFIG_TASK_WDT_TIMEOUT_S=10
CONFIG_ESP32_ENABLE_COREDUMP=y
CONFIG_TIMER_TASK_STACK_SIZE=4096
CONFIG_ESP32_ENABLE_COREDUMP_TO_FLASH=y
CONFIG_SPIRAM_SUPPORT=y
CONFIG_WIFI_LWIP_ALLOCATION_FROM_SPIRAM_FIRST=y
CONFIG_ESP32_DEFAULT_CPU_FREQ_240=y

#
# Wi-Fi
#
CONFIG_ESP32_WIFI_AMPDU_TX_ENABLED=
CONFIG_ESP32_WIFI_AMPDU_RX_ENABLED=

# Enable FATFS read only with long filename support
# for loading Cert/CA/etc from filesystem
# (if enabled in config)
CONFIG_FATFS_CODEPAGE_437=y
CONFIG_FATFS_LFN_HEAP=y

#
# RTCIO configuration
#
CONFIG_RTCIO_SUPPORT_RTC_GPIO_DESC=y
```

## screen/main/Kconfig.projbuild
```kconfig
menu "Exoskeleton Screen Configuration"
    menu "Mesh Configuration"
    config MESH_ID
        string "Mesh ID"
        default "123456"
        help
            Mesh network identification, Nodes with the same mesh ID can
            communicate with each other.

    config MESH_PASSWORD
        string "Mesh Password"
        default "12345678"
        help
            Mesh AP password. Password length must be 8 bits smaller than 64 bits,Set to null to not encrypt
    endmenu
endmenu
```
